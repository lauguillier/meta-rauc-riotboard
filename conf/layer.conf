## conf/layer.conf
```bitbake
# We have a conf and classes directory, add to BBPATH
BBPATH .= ":${LAYERDIR}"

# We have recipes-* directories, add to BBFILES
BBFILES += "${LAYERDIR}/recipes-*/*/*.bb \
	${LAYERDIR}/recipes-*/*/*.bbappend"

BBFILE_COLLECTIONS += "rauc-riotboard"
BBFILE_PATTERN_rauc-riotboard = "^${LAYERDIR}/"
BBFILE_PRIORITY_rauc-riotboard = "7"

# Additional license directories.
LICENSE_PATH += "${LAYERDIR}/files/custom-licenses"

CORE_IMAGE_EXTRA_INSTALL_append = " rauc rauc-hawkbit rauc-hawkbit-service"

IMAGE_FSTYPES_append = " rauc-sdimg"
IMAGE_CLASSES += "image_types_rauc"
BOOT_SCRIPTS += " boot.scr"
```
